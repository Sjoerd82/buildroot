## buildroot-2018.02-rc3/package/arctura/python-libpulseaudio/Config.in
```kconfig
config BR2_PACKAGE_PYTHON_LIBPULSEAUDIO
	bool "python-libpulseaudio"
	help
	  simple libpulseaudio bindings

	  https://pypi.python.org/pypi/libpulseaudio
```

## buildroot-2018.02-rc3/package/arctura/python-oauth2client/Config.in
```kconfig
config BR2_PACKAGE_PYTHON_OAUTH2CLIENT
	bool "python-oauth2client"
	help
	  oauth2client is a client library for OAuth 2.0

	  https://pypi.python.org/pypi/oauth2client
```

## buildroot-2018.02-rc3/package/arctura/python-pid/Config.in
```kconfig
config BR2_PACKAGE_PYTHON_PID
	bool "python-pid"
	#select BR2_PACKAGE_PYTHON_NOSE
	help
	  Pidfile featuring stale detection and file-locking,
	  can also be used as context-manager or decorator

	  https://pypi.python.org/pypi/pid/2.1.1
```

## buildroot-2018.02-rc3/package/arctura/python-pylast/Config.in
```kconfig
config BR2_PACKAGE_PYTHON_PYLAST
	bool "python-pylast"
	help
	  A Python interface to Last.fm and Libre.fm

	  https://pypi.python.org/pypi/pylast
```

## buildroot-2018.02-rc3/package/arctura/python-regex/Config.in
```kconfig
config BR2_PACKAGE_PYTHON_REGEX
        bool "python-regex"
        help
          Alternative regular expression module, to replace re.

          https://pypi.python.org/pypi/regex
```

## buildroot-2018.02-rc3/package/arctura/python-rsa/Config.in
```kconfig
config BR2_PACKAGE_PYTHON_RSA
	bool "python-rsa"
	help
	  Pure-Python RSA implementation

	  https://pypi.python.org/pypi/rsa
```

## buildroot-2018.02-rc3/package/arctura/python-wtforms/Config.in
```kconfig
config BR2_PACKAGE_PYTHON_WTFORMS
	bool "python-wtforms"
	help
	  A flexible forms validation and rendering library for python web development.

	  https://pypi.python.org/pypi/WTForms
```

## buildroot-2018.02-rc3/package/arctura/python-yapsy/Config.in
```kconfig
config BR2_PACKAGE_PYTHON_YAPSY
	bool "python-yapsy"
	help
	  Yet another plugin system

	  https://pypi.python.org/pypi/Yapsy
```

## buildroot-2018.02-rc3/package/arctura/rpi_ws281x/Config.in
```kconfig
config BR2_PACKAGE_RPI_WS281X
	bool "rpi_ws281x"
	select HOST_SCONS
	select SWIG
	help
	  Userspace Raspberry Pi PWM library for WS281X LEDs

	  https://github.com/jgarff/rpi_ws281x
```
