## buildroot-2017.08/configs/headunit_defconfig
```kconfig
BR2_arm=y
BR2_arm1176jzf_s=y
BR2_PACKAGE_HOST_LINUX_HEADERS_CUSTOM_4_9=y
BR2_TOOLCHAIN_BUILDROOT_LOCALE=y
BR2_TOOLCHAIN_BUILDROOT_CXX=y
BR2_TARGET_GENERIC_HOSTNAME="headunit"
BR2_TARGET_GENERIC_ISSUE="Welcome to piHeadUnit"
BR2_ROOTFS_DEVICE_CREATION_DYNAMIC_EUDEV=y
BR2_ROOTFS_DEVICE_TABLE_SUPPORTS_EXTENDED_ATTRIBUTES=y
BR2_TARGET_GENERIC_ROOT_PASSWD="kungfu"
BR2_TARGET_GENERIC_GETTY_PORT="tty1"
BR2_TARGET_GENERIC_GETTY_BAUDRATE_38400=y
BR2_SYSTEM_DHCP="wlan0"
BR2_ROOTFS_OVERLAY="board/arctura/overlay_hu"
BR2_ROOTFS_POST_BUILD_SCRIPT="board/arctura/post-build.sh"
BR2_ROOTFS_POST_FAKEROOT_SCRIPT="board/arctura/fakeroot.sh"
BR2_ROOTFS_POST_IMAGE_SCRIPT="board/arctura/post-image.sh"
BR2_LINUX_KERNEL=y
BR2_LINUX_KERNEL_CUSTOM_GIT=y
BR2_LINUX_KERNEL_CUSTOM_REPO_URL="https://github.com/raspberrypi/linux.git"
BR2_LINUX_KERNEL_CUSTOM_REPO_VERSION="9126e25b0934bd7bd843763310ea4b34c6e139d0"
BR2_LINUX_KERNEL_DEFCONFIG="bcmrpi"
BR2_LINUX_KERNEL_DTS_SUPPORT=y
BR2_LINUX_KERNEL_INTREE_DTS_NAME="bcm2708-rpi-b-plus bcm2708-rpi-0-w"
BR2_PACKAGE_BUSYBOX_INDIVIDUAL_BINARIES=y
BR2_PACKAGE_UDISKS_GLUE=y
BR2_PACKAGE_WIRINGPI=y
BR2_PACKAGE_PYTHON_PULSECTL=y
BR2_PACKAGE_PYTHON_PID_LOCAL=y
BR2_PACKAGE_PYTHON_ADAFRUIT_PUREIO=y
BR2_PACKAGE_PYTHON_ADAFRUIT_GPIO=y
BR2_PACKAGE_PYTHON_ADS1X15=y
BR2_PACKAGE_PYTHON_MPD2=y
BR2_PACKAGE_ALSA_UTILS=y
BR2_PACKAGE_ALSA_UTILS_ALSACONF=y
BR2_PACKAGE_ALSA_UTILS_ACONNECT=y
BR2_PACKAGE_ALSA_UTILS_ALSALOOP=y
BR2_PACKAGE_ALSA_UTILS_ALSAUCM=y
BR2_PACKAGE_ALSA_UTILS_ALSATPLG=y
BR2_PACKAGE_ALSA_UTILS_AMIDI=y
BR2_PACKAGE_ALSA_UTILS_AMIXER=y
BR2_PACKAGE_ALSA_UTILS_APLAY=y
BR2_PACKAGE_ALSA_UTILS_APLAYMIDI=y
BR2_PACKAGE_ALSA_UTILS_ARECORDMIDI=y
BR2_PACKAGE_ALSA_UTILS_ASEQDUMP=y
BR2_PACKAGE_ALSA_UTILS_ASEQNET=y
BR2_PACKAGE_ALSA_UTILS_BAT=y
BR2_PACKAGE_ALSA_UTILS_IECSET=y
BR2_PACKAGE_ALSA_UTILS_SPEAKER_TEST=y
BR2_PACKAGE_ATEST=y
BR2_PACKAGE_MPD=y
BR2_PACKAGE_MPD_BZIP2=y
BR2_PACKAGE_MPD_SQLITE=y
BR2_PACKAGE_MPD_LIBSAMPLERATE=y
BR2_PACKAGE_MPD_LIBSOXR=y
BR2_PACKAGE_MPD_AUDIOFILE=y
BR2_PACKAGE_MPD_DSD=y
BR2_PACKAGE_MPD_FAAD2=y
BR2_PACKAGE_MPD_FFMPEG=y
BR2_PACKAGE_MPD_FLAC=y
BR2_PACKAGE_MPD_LIBSNDFILE=y
BR2_PACKAGE_MPD_MPG123=y
BR2_PACKAGE_MPD_MUSEPACK=y
BR2_PACKAGE_MPD_OPUS=y
BR2_PACKAGE_MPD_TREMOR=y
BR2_PACKAGE_MPD_VORBIS=y
BR2_PACKAGE_MPD_WAVPACK=y
BR2_PACKAGE_MPD_PULSEAUDIO=y
BR2_PACKAGE_MPD_MPC=y
BR2_PACKAGE_PULSEAUDIO_DAEMON=y
BR2_PACKAGE_LZ4=y
BR2_PACKAGE_LZIP=y
BR2_PACKAGE_XZ=y
BR2_PACKAGE_ZIP=y
BR2_PACKAGE_GIT=y
BR2_PACKAGE_RPI_BT_FIRMWARE=y
BR2_PACKAGE_RPI_FIRMWARE=y
BR2_PACKAGE_RPI_FIRMWARE_X=y
BR2_PACKAGE_RPI_WIFI_FIRMWARE=y
BR2_PACKAGE_DBUS_PYTHON=y
BR2_PACKAGE_EUDEV_RULES_GEN=y
BR2_PACKAGE_RFKILL=y
BR2_PACKAGE_SPI_TOOLS=y
BR2_PACKAGE_UDISKS=y
BR2_PACKAGE_UDISKS_LVM2=y
BR2_PACKAGE_PYTHON_ZLIB=y
BR2_PACKAGE_PYTHON_ALSAAUDIO=y
BR2_PACKAGE_PYTHON_GOBJECT=y
BR2_PACKAGE_PYTHON_PICKLESHARE=y
BR2_PACKAGE_PYTHON_SMBUS_CFFI=y
BR2_PACKAGE_SBC=y
BR2_PACKAGE_LIBARCHIVE=y
BR2_PACKAGE_LZO=y
BR2_PACKAGE_BLUEZ_TOOLS=y
BR2_PACKAGE_BLUEZ5_UTILS=y
BR2_PACKAGE_BLUEZ5_UTILS_OBEX=y
BR2_PACKAGE_BLUEZ5_UTILS_CLIENT=y
BR2_PACKAGE_BLUEZ5_UTILS_DEPRECATED=y
BR2_PACKAGE_BLUEZ5_UTILS_EXPERIMENTAL=y
BR2_PACKAGE_BLUEZ5_PLUGINS_HEALTH=y
BR2_PACKAGE_BLUEZ5_PLUGINS_MIDI=y
BR2_PACKAGE_BLUEZ5_PLUGINS_NFC=y
BR2_PACKAGE_BLUEZ5_PLUGINS_SAP=y
BR2_PACKAGE_BLUEZ5_UTILS_TEST=y
BR2_PACKAGE_DHCPCD=y
BR2_PACKAGE_DROPBEAR=y
BR2_PACKAGE_IPROUTE2=y
BR2_PACKAGE_IPTABLES=y
BR2_PACKAGE_SAMBA4=y
BR2_PACKAGE_WIRELESS_TOOLS=y
BR2_PACKAGE_WIRELESS_TOOLS_LIB=y
BR2_PACKAGE_WPA_SUPPLICANT=y
BR2_PACKAGE_WPA_SUPPLICANT_AP_SUPPORT=y
BR2_PACKAGE_WPA_SUPPLICANT_WIFI_DISPLAY=y
BR2_PACKAGE_WPA_SUPPLICANT_EAP=y
BR2_PACKAGE_WPA_SUPPLICANT_CLI=y
BR2_PACKAGE_WPA_SUPPLICANT_WPA_CLIENT_SO=y
BR2_PACKAGE_WPA_SUPPLICANT_PASSPHRASE=y
BR2_PACKAGE_INOTIFY_TOOLS=y
BR2_PACKAGE_UTIL_LINUX_BINARIES=y
BR2_PACKAGE_UTIL_LINUX_AGETTY=y
BR2_PACKAGE_UTIL_LINUX_MOUNT=y
BR2_PACKAGE_UTIL_LINUX_MOUNTPOINT=y
BR2_TARGET_ROOTFS_EXT2=y
BR2_TARGET_ROOTFS_EXT2_4=y
BR2_TARGET_ROOTFS_EXT2_LABEL="PIHU"
BR2_TARGET_ROOTFS_EXT2_SIZE="1G"
# BR2_TARGET_ROOTFS_TAR is not set
BR2_PACKAGE_HOST_DOSFSTOOLS=y
BR2_PACKAGE_HOST_GENIMAGE=y
BR2_PACKAGE_HOST_MTOOLS=y
```

## buildroot-2017.08/package/arctura/ecasound/Config.in
```kconfig
config BR2_PACKAGE_ECASOUND
	bool "ecasound"
	help
	  Ecasound is a software package designed for
          multitrack audio processing.

	  https://ecasound.seul.org/ecasound/
```

## buildroot-2017.08/package/arctura/python-adafruit_gpio/Config.in
```kconfig
config BR2_PACKAGE_PYTHON_ADAFRUIT_GPIO
	bool "python-adafruit_gpio"
	help
	  Library to provide a cross-platform GPIO interface on
	  the Raspberry Pi and Beaglebone Black using the
	  RPi.GPIO and Adafruit_BBIO libraries.

	  https://pypi.python.org/pypi/Adafruit-GPIO
```

## buildroot-2017.08/package/arctura/python-mpd2/Config.in
```kconfig
config BR2_PACKAGE_PYTHON_MPD2
	bool "python-mpd2"
	help
	  python-mpd2 is a Python library which provides a client
          interface for the Music Player Daemon.

	  https://pypi.python.org/pypi/python-mpd2
```

## buildroot-2017.08/package/arctura/python-pid-local/Config.in
```kconfig
config BR2_PACKAGE_PYTHON_PID_LOCAL
	bool "python-pid-local"
	help
	  Pidfile featuring stale detection and file-locking,
	  can also be used as context-manager or decorator

	  https://pypi.python.org/pypi/pid/2.1.1
```

## buildroot-2017.08/package/arctura/python-pid/Config.in
```kconfig
config BR2_PACKAGE_PYTHON_PID
	bool "python-pid"
	help
	  Pidfile featuring stale detection and file-locking,
	  can also be used as context-manager or decorator

	  https://pypi.python.org/pypi/pid/2.1.1
```

## buildroot-2017.08/package/arctura/python-pidfile/Config.in
```kconfig
config BR2_PACKAGE_PYTHON_PIDFILE
	bool "python-pidfile"
	help
	  PIDFile context processor. Supported py2 and py3

	  https://pypi.python.org/pypi/python-pidfile/
```

## buildroot-2017.08/package/arctura/python-pulsectl/Config.in
```kconfig
config BR2_PACKAGE_PYTHON_PULSECTL
	bool "python-pulsectl"
	help
	  Python high-level interface and ctypes-based bindings
          for PulseAudio (libpulse)

	  https://pypi.python.org/pypi/pulsectl
```

## buildroot-2017.08/package/arctura/python-pycryptodome/Config.in
```kconfig
config BR2_PACKAGE_PYTHON_PYCRYPTODOME
	bool "python-pycryptodome"
	help
	  Cryptographic library for Python

	  https://pypi.python.org/pypi/pycryptodome
```

## buildroot-2017.08/package/arctura/python-unidecode/Config.in
```kconfig
config BR2_PACKAGE_PYTHON_UNIDECODE
	bool "python-unidecode"
	help
	  ASCII transliterations of Unicode text

	  https://pypi.python.org/pypi/Unidecode
```

## buildroot-2017.08/package/arctura/udisks-glue/Config.in
```kconfig
config BR2_PACKAGE_UDISKS_GLUE
	bool "udisks-glue"
	help
	  Utility to associate udisks events to user-defined actions.

	  https://github.com/fernandotcl/udisks-glue
```

## buildroot-2018.02-rc2/package/arctura/Config.in
```kconfig
#menu "Arctura"
        source "package/arctura/udisks-glue/Config.in"
        source "package/arctura/wiringpi/Config.in"
        source "package/arctura/python-cython/Config.in"
	source "package/arctura/ecasound/Config.in"
	source "package/arctura/ladspa-sdk/Config.in"
	source "package/arctura/rt-plugins/Config.in"

if BR2_PACKAGE_PYTHON || BR2_PACKAGE_PYTHON3
menu "External python modules"
        source "package/arctura/python-adafruit_gpio/Config.in"
        source "package/arctura/python-adafruit-pureio/Config.in"
        source "package/arctura/python-ads1x15/Config.in"
	source "package/arctura/python-awesome-slugify/Config.in"
        source "package/arctura/python-colored/Config.in"
	source "package/arctura/python-flask-wtf/Config.in"
        source "package/arctura/python-libpulseaudio/Config.in"
        source "package/arctura/python-MechanicalSoup/Config.in"
        source "package/arctura/python-mpd/Config.in"
        source "package/arctura/python-mpd2/Config.in"
        source "package/arctura/python-nose/Config.in"
        source "package/arctura/python-oauth2client/Config.in"
        source "package/arctura/python-pid/Config.in"
        source "package/arctura/python-pidfile/Config.in"
        source "package/arctura/python-pulsectl/Config.in"
        source "package/arctura/python-pycryptodome/Config.in"
        source "package/arctura/python-pylast/Config.in"
        source "package/arctura/python-pytest-runner/Config.in"
        source "package/arctura/python-rsa/Config.in"
	source "package/arctura/python-regex/Config.in"
        source "package/arctura/python-rplcd/Config.in"
        source "package/arctura/python-tendo/Config.in"
        source "package/arctura/python-unidecode/Config.in"
endmenu
endif
#endmenu
```

## buildroot-2018.02-rc2/package/arctura/ecasound/Config.in
```kconfig
config BR2_PACKAGE_ECASOUND
	bool "ecasound"
	select BR2_PACKAGE_READLINE
	help
	  Ecasound is a software package designed for multitrack audio processing.

	  https://ecasound.seul.org/ecasound/
```

## buildroot-2018.02-rc2/package/arctura/ladspa-sdk/Config.in
```kconfig
config BR2_PACKAGE_LADSPA_SDK
	bool "ladspa-sdk"
	help
	  LADSPA is a standard that allows software audio processors and
	  effects to be plugged into a wide range of audio synthesis and
	  recording packages.

	  http://www.ladspa.org/
```

## buildroot-2018.02-rc2/package/arctura/python-ads1x15/Config.in
```kconfig
config BR2_PACKAGE_PYTHON_ADS1X15
	bool "python-ads1x15"
	help
	  Python code to use the ADS1015 and ADS1115 analog to
          digital converters with a Raspberry Pi or BeagleBone
          black.

	  https://pypi.python.org/pypi/Adafruit-ADS1x15
```

## buildroot-2018.02-rc2/package/arctura/python-flask-wtf/Config.in
```kconfig
config BR2_PACKAGE_PYTHON_FLASK_WTF
	bool "python-flask-wtf"
	select BR2_PACKAGE_PYTHON_WTFORMS
	help
	  Simple integration of Flask and WTForms.

	  https://pypi.python.org/pypi/Flask-WTF
```

## buildroot-2018.02-rc2/package/arctura/python-mpd/Config.in
```kconfig
config BR2_PACKAGE_PYTHON_PYTHON-MPD
	bool "python-mpd"
	help
	  An MPD (Music Player Daemon) client library written in pure
          Python.

	  https://pypi.python.org/pypi/python-mpd
```

## buildroot-2018.02-rc2/package/arctura/python-tendo/Config.in
```kconfig
config BR2_PACKAGE_PYTHON_TENDO
	bool "python-tendo"
	help
	  Tendo is a python module that adds basic functionality that
          is not (yet) provided by Python.

	  https://pypi.python.org/pypi/tendo
```

## buildroot-2018.02-rc2/package/arctura/rt-plugins/Config.in
```kconfig
config BR2_PACKAGE_RT_PLUGINS
	bool "rt-plugins"
	help
          LADSPA plugins for Active Loudspeakers

	  http://faculty.tru.ca/rtaylor/rt-plugins/index.html
```

## buildroot-2018.02-rc3/package/arctura/ecasound/Config.in
```kconfig
config BR2_PACKAGE_ECASOUND
	bool "ecasound"
	select BR2_PACKAGE_READLINE
	select BR2_JACK2
	help
	  Ecasound is a software package designed for multitrack audio processing.

	  https://ecasound.seul.org/ecasound/
```

## buildroot-2018.02-rc3/package/arctura/ladspa-sdk/Config.in
```kconfig
config BR2_PACKAGE_LADSPA_SDK
	bool "ladspa-sdk"
	select BR2_INSTALL_LIBSDTCPP
	help
	  LADSPA is a standard that allows software audio processors and
	  effects to be plugged into a wide range of audio synthesis and
	  recording packages.

	  http://www.ladspa.org/
```

## buildroot-2018.02-rc3/package/arctura/python-MechanicalSoup/Config.in
```kconfig
config BR2_PACKAGE_PYTHON_MECHANICALSOUP
	bool "python-MechanicalSoup"
	help
	  A Python library for automating interaction with websites

	  https://pypi.python.org/pypi/MechanicalSoup
```

## buildroot-2018.02-rc3/package/arctura/python-awesome-slugify/Config.in
```kconfig
config BR2_PACKAGE_PYTHON_AWESOME_SLUGIFY
        bool "python-awesome-slugify"
        help
          Python flexible slugify function

          https://pypi.python.org/pypi/awesome-slugify
```

## buildroot-2018.02-rc3/package/arctura/python-colored/Config.in
```kconfig
config BR2_PACKAGE_PYTHON_COLORED
	bool "python-colored"
	help
	  Simple library for color and formatting to terminal

	  https://pypi.python.org/pypi/colored
```

## buildroot-2018.02-rc3/package/arctura/python-flask-restful/Config.in
```kconfig
config BR2_PACKAGE_PYTHON_FLASK_RESTFUL
	bool "python-flask-restful"
	select BR2_PACKAGE_PYTHON_FLASK
	help
	  Simple framework for creating REST APIs

	  https://pypi.python.org/pypi/Flask-RESTful
```
